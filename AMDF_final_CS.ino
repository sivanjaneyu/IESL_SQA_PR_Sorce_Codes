#include <LiquidCrystal.h>
const int rs = 12, en = 11, d4 = 5, d5 = 4, d6 = 3, d7 = 2;
LiquidCrystal lcd(rs, en, d4, d5, d6, d7);

unsigned long t1,t2,t3,t4;
const int Fs1=125;
const int CR=2;
const int p=6; //length of a and b (order of filter+1)
float b[6]={0.864246524017246,-4.32123262008623,8.64246524017246,-8.64246524017246,4.32123262008623,-0.864246524017246};
float a[6]={1,-4.70835055262605,8.87551850311413,-8.37268603379321,3.95242919071962,-0.746904488298868};
const float Fs=(Fs1/2);
const int t=5;
const int N=Fs1*t;
const int M=Fs*t;
int i, PR, SQ=1;

float x1[N]={0.0017836387974579,0.106216600499354,0.211553743687847,0.308753253496972,0.390581678033955,0.453874382095711,0.497727184195641,0.525304719536835,0.53931953257908,0.54203207703887,0.537059078862589,0.527113082510028,0.513098269467782,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0.249529366124901,0.200251475105391}; //original signal
//float x1[N];  //real-time sensing
float x2[N]; //CS signal
float x3[N]; //Normalsed signal
float x4[N];  //Filtered signal
float x5[N];  // Normalized signals
const int k=250; // length of partial AMDF
float th=-0.25; //Threshold for threshold crossing of derivative
int ZC[M];
int AMDF_zc[k]; //Threshold crossings of AMDF_ds
int num,N1,N2,Z;     //Number of th crossings
float AMDF_val[k];     //AMDF function
float AMDF_d[k];   //Derivative of AMDF
float AMDF_neg[k];   //Negative of AMDF
float AMDF_ds[k];  //Smoothed derivative of AMDF
// float der[k],der1[k],der2[k];
float xd[M - 1], xs[M- 1];

void setup() {
  Serial.begin(9600);
  Serial1.begin(9600);
  lcd.begin(16, 2);
  lcd.setCursor(0, 0);
  lcd.print("Initializing...");
  delay(1000);
}

void loop() {
  t1=micros();

// //Real-time sensing
//    i=0;
//    while(i<samples)
//    {
//      x1[i]=analogRead(A0);
//      delay(8);
//      i=i+1;
//    }

  DBBD(x1,N,CR,x2);
//  normalize_amplitude(x2, M, x3);
  filtfilt(x2, M, a, b, p, x4);

  derivative(x4, M, xd);
  MAF(xd, M - 1, 3, xs);
  int NPZCR = msm_zerocros(xs, M - 1, ZC);

  t2 = micros();
  AMDF(x4, M, k, AMDF_val);
  t3 = micros();
  mean_removal(AMDF_val, k, AMDF_val);
  normalize_amplitude(AMDF_val, k, AMDF_val);
  for (i = 0; i < k; i++) AMDF_neg[i] = -AMDF_val[i];
  derivative(AMDF_neg, k, AMDF_ds);
  k_lag(AMDF_ds, k, 5, AMDF_ds);
  normalize_amplitude(AMDF_ds, k, AMDF_ds);

  num = neg_th_cross(AMDF_ds, th, k, AMDF_zc);
  if (num < 2) {
    SQ = 1;
    PR = 0;
  } else {
    minima_correction(AMDF_val, k, AMDF_zc, num, AMDF_zc);
    PR = ceil(Fs * 60.0 / (AMDF_zc[0] + 1));
  }

  t4 = micros();
  N1 = neg_th_cross(x4, 0.1, M, ZC);
  N2 = neg_th_cross(x4, -0.1, M, ZC);
  Z = abs(N1 - N2);

  // Magnitude computation
  float max_val = x4[0], min_val = x4[0];
  for (int i = 1; i < M; i++) {
    if (x4[i] > max_val) max_val = x4[i];
    if (x4[i] < min_val) min_val = x4[i];
  }
  float mag = max_val - min_val;

  // Signal Quality Check
  if (NPZCR > 8 && NPZCR <= 38) SQ = 0;
  else if (NPZCR > 38 && NPZCR < 168) SQ = 1;
  else if (num < 2 || PR < 30 || PR > 300) SQ = 1;
  else if ((AMDF_val[AMDF_zc[0]] > -0.13 && AMDF_val[AMDF_zc[1]] > -0.35) && mag > 64) SQ = 1;
  else if ((AMDF_val[AMDF_zc[0]] < -0.37 && AMDF_val[AMDF_zc[1]] < -0.34) && mag <= 9) SQ = 0;
  else {
    for (int i = 0; i < num - 2; i++) {
      int d1 = AMDF_zc[i + 1] - AMDF_zc[i];
      int d2 = AMDF_zc[i + 2] - AMDF_zc[i + 1];
      int dist = abs(d2 - d1);
      if (dist > 8) {
        SQ = 1;
        break;
      } else {
        SQ = 0;
      }
    }
  }

  // Serial output
  Serial.print("PR is,"); Serial.println(PR);
  Serial.print("Signal Quality is,"); Serial.println(SQ);

  Serial1.print("PR is,"); Serial1.println(PR);
  Serial1.print("Signal Quality is,"); Serial1.println(SQ);

  // LCD Display
  lcd.clear();
  lcd.setCursor(0, 0);
  lcd.print("PR (bpm): "); lcd.print(PR);
  lcd.setCursor(0, 1);
  lcd.print("SQA: "); lcd.print((SQ == 0) ? "Good Quality" : "Bad Quality");
//  lcd.setCursor(0, 0);
//  lcd.print("CS Matrix: "); lcd.print("DBBD");
//  lcd.setCursor(0, 1);
//  lcd.print("CR: "); lcd.print(CR);

  
  delay(1000);

}

// Supporting Functions 

void DBBD(float x[], int N, int CR, float y[]){

//  Function to find CS measurements using DBBD sensing matrix
//  Input: signal x with length N
//  Output: signal y compressed by CR factor
//  New length: M=floor(N/CR)

    int i,j,M,temp;
    M=floor(N/CR);

    for (int j=0;j<M;j++){
      y[j]=0;
      for (int i=0;i<CR;i++){
        temp=j*CR+i;
        y[j]=y[j]+x[temp];
      }
    }
}


void normalize_amplitude(float x[], int N, float y[]) {
  float max_x = fabs(x[0]);
  for (int i = 1; i < N; i++) max_x = max(max_x, fabs(x[i]));
  for (int i = 0; i < N; i++) y[i] = x[i] / max_x;
}

void AMDF(float x[], int N, int M, float y[]) {
  for (int i = 0; i < M; i++) {
    float sum = 0;
    for (int j = 0; j < N - i - 1; j++) sum += fabs(x[j] - x[j + i]);
    y[i] = sum / (N - i - 1);
  }
}

void mean_removal(float x[], int N, float y[]) {
  float sum = 0;
  for (int i = 0; i < N; i++) sum += x[i];
  float avg = sum / N;
  for (int i = 0; i < N; i++) y[i] = x[i] - avg;
}

void k_lag(float x[], int N, int p, float y[]) {
  for (int i = 0; i < p; i++) y[i] = x[p];
  for (int i = p; i < N; i++) y[i] = x[i];
}

int neg_th_cross(float x[], float th, int N, int y[]) {
  int j = 0;
  for (int i = 0; i < N - 1; i++) {
    if (x[i] > th && x[i + 1] <= th) y[j++] = i;
  }
  if (j == 0) {
    y[0] = N - 1;
    return 1;
  }
  return j;
}

void minima_correction(float x[], int N, int loc[], int M, int y[]) {
  for (int i = 0; i < M; i++) {
    float minima = x[loc[i]];
    y[i] = loc[i];
    int start = max(0, loc[i] - 3);
    int end = min(N - 1, loc[i] + 3);
    for (int j = start; j <= end; j++) {
      if (x[j] < minima) {
        minima = x[j];
        y[i] = j;
      }
    }
  }
}

void filtfilt(float x[], int N, float a[], float b[], int p, float y[]) {
  float z[N];
  filter(x, N, a, b, p, z);
  for (int i = 0; i < N; i++) y[i] = z[N - i - 1];
  filter(y, N, a, b, p, z);
  for (int i = 0; i < N; i++) y[i] = z[N - i - 1];
}

void filter(float x[], int N, float a[], float b[], int p, float y[]) {
  for (int i = 0; i < N; i++) {
    float val = 0;
    for (int j = 1; j < p && i >= j; j++) {
      val += b[j] * x[i - j] - a[j] * y[i - j];
    }
    y[i] = b[0] * x[i] + val;
  }
}

void MAF(float x[], int N, int p, float y[]) {
  float a[p], b[p];
  for (int i = 0; i < p; i++) {
    a[i] = (i == 0) ? 1 : 0;
    b[i] = 1.0 / p;
  }
  filtfilt(x, N, a, b, p, y);
}

void derivative(float x[], int N, float y[]) {
  for (int i = 0; i < N - 1; i++) y[i] = x[i + 1] - x[i];
  y[N - 1] = y[N - 2];
}

int msm_zerocros(float* signal, int len, int* locations) {
  int count = 0;
  for (int i = 1; i < len; i++) {
    if (signal[i] * signal[i - 1] <= 0) {
      locations[count++] = i;
    }
  }
  return count;
}
